## main/Kconfig.projbuild
```kconfig
menu "Gas Meter Configuration"

    config REED_SENSOR_GPIO
        int "Reed sensor GPIO pin"
        default 7
        help
            GPIO pin connected to the reed sensor of the gas meter.
            The pin is configured with an internal pull-up; the reed
            switch should pull it to ground when closed.

    config IDENTIFY_LED_GPIO
        int "Identification LED GPIO pin"
        default 15
        help
            GPIO pin connected to the onboard LED used for
            Matter Identify cluster visual feedback.

endmenu
```

## sdkconfig.defaults
```kconfig
# Enable HKDF in mbedtls (required by Matter)
CONFIG_MBEDTLS_HKDF_C=y

# Custom partition table for larger app binary
CONFIG_PARTITION_TABLE_CUSTOM=y
CONFIG_PARTITION_TABLE_FILENAME="partitions.csv"

# Enable BT (required by Matter for commissioning)
CONFIG_BT_ENABLED=y
CONFIG_BT_NIMBLE_ENABLED=y

# Disable BT connection reattempt
CONFIG_BT_NIMBLE_ENABLE_CONN_REATTEMPT=n

# Enable lwIP IPv6 autoconfig
CONFIG_LWIP_IPV6_AUTOCONFIG=y

# Enable lwIP route hooks
CONFIG_LWIP_HOOK_IP6_ROUTE_DEFAULT=y
CONFIG_LWIP_HOOK_ND6_GET_GW_DEFAULT=y

# Increase LwIP IPv6 address number to 6 (MAX_FABRIC + 1)
CONFIG_LWIP_IPV6_NUM_ADDRESSES=6

# Use 4MB flash
CONFIG_ESPTOOLPY_FLASHSIZE_4MB=y

# Disable softap by default
CONFIG_ESP_WIFI_SOFTAP_SUPPORT=n

# Thread-only: disable WiFi station so the commissioner uses Thread
CONFIG_ENABLE_WIFI_STATION=n

# Thread-only: use platform DNS-SD (SRP) instead of minimal mDNS (UDP multicast)
# Minimal mDNS cannot advertise on Thread — services must go through the
# Border Router's SRP server so its mDNS proxy can answer on behalf of the device.
CONFIG_USE_MINIMAL_MDNS=n

# Thread is IPv6-only
CONFIG_DISABLE_IPV4=y
CONFIG_LWIP_IPV4=n

# Disable ClosureControl/Dimension clusters (broken with GCC 14, not needed)
CONFIG_SUPPORT_CLOSURE_CONTROL_CLUSTER=n
CONFIG_SUPPORT_CLOSURE_DIMENSION_CLUSTER=n

# Thread: Enable OpenThread and set as Minimal Thread Device (required for SED / ICD)
CONFIG_OPENTHREAD_ENABLED=y
CONFIG_OPENTHREAD_MTD=y

# Matter ICD: Long Idle Time mode (per Matter spec §9.15.1.6–7)
CONFIG_ENABLE_ICD_SERVER=y
CONFIG_ENABLE_ICD_LIT=y
CONFIG_ENABLE_ICD_CIP=y

# Idle mode: poll parent every 120s, stay idle up to 15 min (900s)
CONFIG_ICD_SLOW_POLL_INTERVAL_MS=120000
CONFIG_ICD_IDLE_MODE_INTERVAL_SEC=900

# Active mode: poll every 500ms, stay active for 10s (event-driven via ICDNotifier)
CONFIG_ICD_FAST_POLL_INTERVAL_MS=500
CONFIG_ICD_ACTIVE_MODE_INTERVAL_MS=0
CONFIG_ICD_ACTIVE_MODE_THRESHOLD_MS=10000

# Report pending attribute changes when entering active mode
CONFIG_ICD_REPORT_ON_ACTIVE_MODE=y

# Automatic light sleep: CPU sleeps between RTOS ticks, GPIO interrupt wakes it
CONFIG_PM_ENABLE=y
CONFIG_FREERTOS_USE_TICKLESS_IDLE=y

# Lower CPU frequency (80 MHz is sufficient for a sensor)
CONFIG_ESP_DEFAULT_CPU_FREQ_MHZ_80=y

# Enable GetClock_RealTime() so the Time Synchronization cluster can read back
# UTC time set via SetUTCTime. This flag only ungates gettimeofday() in
# SystemTimeSupport.cpp — it does NOT start an SNTP client.
# See README TODO about the upstream CHIP bug.
CONFIG_ENABLE_SNTP_TIME_SYNC=y

# CHIP project config: overrides vendor/product name and software version
CONFIG_CHIP_PROJECT_CONFIG="main/CHIPProjectConfig.h"
```
